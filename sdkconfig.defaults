## sdkconfig.defaults
```kconfig
# ESP32-S3 target
CONFIG_IDF_TARGET="esp32s3"

# Flash & PSRAM
CONFIG_ESPTOOLPY_FLASHSIZE_16MB=y
CONFIG_SPIRAM=y
CONFIG_SPIRAM_MODE_OCT=y
CONFIG_SPIRAM_SPEED_80M=y
CONFIG_SPIRAM_USE_MALLOC=y
CONFIG_ESP32S3_DATA_CACHE_64KB=y

# Partition table
CONFIG_PARTITION_TABLE_CUSTOM=y
CONFIG_PARTITION_TABLE_CUSTOM_FILENAME="partitions.csv"

# WiFi
CONFIG_ESP_WIFI_STATIC_RX_BUFFER_NUM=16
CONFIG_ESP_WIFI_DYNAMIC_RX_BUFFER_NUM=64
CONFIG_ESP_WIFI_TX_BUFFER_TYPE_DYNAMIC=y
CONFIG_ESP_WIFI_AMPDU_TX_ENABLED=y
CONFIG_ESP_WIFI_AMPDU_RX_ENABLED=y
# Roaming: allow scanning for better AP on same SSID
CONFIG_ESP_WIFI_SCAN_CACHE_SIZE=16

# MQTT / TLS stack size
CONFIG_MQTT_TASK_STACK_SIZE=8192
CONFIG_ESP_TLS_SKIP_SERVER_CERT_VERIFY=y

# LVGL
CONFIG_LV_MEM_SIZE_KILOBYTES=512
CONFIG_LV_ATTRIBUTE_FAST_MEM_USE_IRAM=y

# Compiler: release-mode optimizations (-O2)
CONFIG_COMPILER_OPTIMIZATION_PERF=y
CONFIG_COMPILER_OPTIMIZATION_ASSERTIONS_SILENT=y

# Logging
CONFIG_LOG_DEFAULT_LEVEL_INFO=y

# FreeRTOS tick rate
CONFIG_FREERTOS_HZ=1000

# Task watchdog
CONFIG_ESP_TASK_WDT_TIMEOUT_S=10
```
